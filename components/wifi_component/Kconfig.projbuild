## components/wifi_component/Kconfig.projbuild
```kconfig
menu "WiFi AP Configuration"

    config AP_SSID
        string "WiFi SSID"
        default "myssid"
        help
            SSID (network name) for the example to connect to.

    config AP_CHANNEL
        int "WiFi Channel"
        range 1 13
        default 1
        help
            WiFi channel (network channel) for the example to use.

    config AP_STA_CONN
        int "Maximal STA connections"
        default 4
        help
            Max number of the STA connects to AP.
endmenu
```

## main/Kconfig.projbuild
```kconfig
menu "Status LED Configuration"

    config STATUS_PERIOD
        int "Blink period in ms"
        range 10 3600000
        default 1000
        help
            Define the blinking period in milliseconds.

endmenu
```
